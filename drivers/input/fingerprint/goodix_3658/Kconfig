## drivers/input/fingerprint/goodix_3658/Kconfig
```kconfig
config GOODIX_FINGERPRINT_3658
	tristate "generic goodix fingerprint driver"
	default n
	help
	add support for goodix fingerprint driver.
```

## drivers/input/touchscreen/synaptics_tcm_zte/Kconfig
```kconfig
#
# Synaptics TCM touchscreen driver configuration
#
menuconfig TOUCHSCREEN_SYNAPTICS_TCM_ZTE
	bool "Synaptics TCM touchscreen"
	default n
	help
	  Say Y here if you have a Synaptics TCM touchscreen connected
	  to your system.

	  If unsure, say N.

if TOUCHSCREEN_SYNAPTICS_TCM_ZTE

choice
	default TOUCHSCREEN_SYNAPTICS_TCM_I2C_ZTE
	prompt "Synaptics TCM bus module"
config TOUCHSCREEN_SYNAPTICS_TCM_I2C_ZTE
	bool "I2C"
	depends on I2C
config TOUCHSCREEN_SYNAPTICS_TCM_SPI_ZTE
	bool "SPI"
	depends on SPI_MASTER
endchoice

config TOUCHSCREEN_SYNAPTICS_TCM_CORE_ZTE
	tristate "Synaptics TCM core module"
	depends on I2C || SPI_MASTER
	default n
	help
	  Say Y here to enable core functionality.

	  If unsure, say N.

	  To compile this driver as a module, choose M here: the
	  module will be called synaptics_tcm_core.

config TOUCHSCREEN_SYNAPTICS_TCM_TOUCH_ZTE
	tristate "Synaptics TCM touch module"
	depends on TOUCHSCREEN_SYNAPTICS_TCM_CORE_ZTE
	default y
	help
	  Say Y here to enable support for touch reporting.

	  If unsure, say N.

	  To compile this driver as a module, choose M here: the
	  module will be called synaptics_tcm_touch.

config TOUCHSCREEN_SYNAPTICS_TCM_DEVICE_ZTE
	tristate "Synaptics TCM device module"
	depends on TOUCHSCREEN_SYNAPTICS_TCM_CORE_ZTE
	default y
	help
	  Say Y here to enable support for TCM device functionality.

	  If unsure, say N.

	  To compile this driver as a module, choose M here: the
	  module will be called synaptics_tcm_device.

config TOUCHSCREEN_SYNAPTICS_TCM_TESTING_ZTE
	tristate "Synaptics TCM testing module"
	depends on TOUCHSCREEN_SYNAPTICS_TCM_CORE_ZTE
	help
	  Say Y here to enable support for testing functionality.

	  If unsure, say N.

	  To compile this driver as a module, choose M here: the
	  module will be called synaptics_tcm_testing.

config TOUCHSCREEN_SYNAPTICS_TCM_REFLASH_ZTE
	tristate "Synaptics TCM reflash module"
	depends on TOUCHSCREEN_SYNAPTICS_TCM_CORE_ZTE
	default y
	help
	  Say Y here to enable support for reflash functionality.

	  If unsure, say N.

	  To compile this driver as a module, choose M here: the
	  module will be called synaptics_tcm_reflash.

config TOUCHSCREEN_SYNAPTICS_TCM_RECOVERY_ZTE
	tristate "Synaptics TCM recovery module"
	depends on TOUCHSCREEN_SYNAPTICS_TCM_CORE_ZTE
	default y
	help
	  Say Y here to enable support for recovery functionality.

	  If unsure, say N.

	  To compile this driver as a module, choose M here: the
	  module will be called synaptics_tcm_recovery.

config TOUCHSCREEN_SYNAPTICS_TCM_ZEROFLASH_ZTE
	tristate "Synaptics TCM zeroflash module"
	depends on TOUCHSCREEN_SYNAPTICS_TCM_CORE_ZTE
	help
	  Say Y here to enable support for ZeroFlash functionality.

	  If unsure, say N.

	  To compile this driver as a module, choose M here: the
	  module will be called synaptics_tcm_zeroflash.

config TOUCHSCREEN_SYNAPTICS_TCM_DIAGNOSTICS_ZTE
	tristate "Synaptics TCM diagnostics module"
	depends on TOUCHSCREEN_SYNAPTICS_TCM_CORE_ZTE
	default y
	help
	  Say Y here to enable support for diagnostics functionality.

	  If unsure, say N.

	  To compile this driver as a module, choose M here: the
	  module will be called synaptics_tcm_diagnostics.

config TOUCHSCREEN_SYNAPTICS_TCM_ROMBOOT_ZTE
	tristate "Synaptics TCM romboot module"
	depends on TOUCHSCREEN_SYNAPTICS_TCM_ZEROFLASH_ZTE
	help
	  Say Y here to enable support for romboot functionality.

	  If unsure, say N.

	  To compile this driver as a module, choose M here: the
	  module will be called synaptics_tcm_diagnostics.

endif
```
